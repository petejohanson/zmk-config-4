## config/boards/shields/10x2/Kconfig.defconfig
```kconfig
# Copyright (c) 2024 miketronic
# SPDX-License-Identifier: MIT

if SHIELD_10x2

config ZMK_KEYBOARD_NAME
	default "10x2"

endif
```

## config/boards/shields/10x2/Kconfig.shield
```kconfig
# Copyright (c) 2024 miketronic
# SPDX-License-Identifier: MIT

config SHIELD_10x2
	def_bool $(shields_list_contains,10x2)
```

## config/west.yml
```yaml
manifest:
  remotes:
    - name: zmkfirmware
      url-base: https://github.com/petejohanson
    - name: miketronic
      url-base: https://github.com/miketronic
  projects:
    - name: zmk
    #  remote: zmkfirmware
    #  revision: feat/pointers-with-input-processors
      remote: miketronic
      revision: rp2040zero
      import: app/west.yml
    - name: zmk-keyboards-10x2
      remote: miketronic
      revision: main
  self:
    path: config
```
