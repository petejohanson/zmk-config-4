/*
 * Copyright (c) 2024 miketronic
 * SPDX-License-Identifier: MIT
 */

#include <dt-bindings/zmk/matrix_transform.h>


/ {
	chosen {
		zmk,kscan = &kscan0;
	};

	kscan0: kscan {
		compatible = "zmk,kscan-gpio-direct", "waveshare_rp2040_zero";

    input-gpios
      = <&gpio0 2 (GPIO_ACTIVE_LOW | GPIO_PULL_UP)> //W
      , <&gpio0 1 (GPIO_ACTIVE_LOW | GPIO_PULL_UP)> //F
      , <&gpio0 0 (GPIO_ACTIVE_LOW | GPIO_PULL_UP)> //G
      , <&gpio0 29 (GPIO_ACTIVE_LOW | GPIO_PULL_UP)> //M
      , <&gpio0 28 (GPIO_ACTIVE_LOW | GPIO_PULL_UP)> //L
      , <&gpio0 27 (GPIO_ACTIVE_LOW | GPIO_PULL_UP)> //U
      , <&gpio0 5 (GPIO_ACTIVE_LOW | GPIO_PULL_UP)>  //A
      , <&gpio0 3 (GPIO_ACTIVE_LOW | GPIO_PULL_UP)>  //R
      , <&gpio0 4 (GPIO_ACTIVE_LOW | GPIO_PULL_UP)>  //S
      , <&gpio0 26 (GPIO_ACTIVE_LOW | GPIO_PULL_UP)> //N
      , <&gpio0 15 (GPIO_ACTIVE_LOW | GPIO_PULL_UP)> //E
      , <&gpio0 14 (GPIO_ACTIVE_LOW | GPIO_PULL_UP)> //I
      , <&gpio0 8 (GPIO_ACTIVE_LOW | GPIO_PULL_UP)>  //C
      , <&gpio0 6 (GPIO_ACTIVE_LOW | GPIO_PULL_UP)>  //D
      , <&gpio0 7 (GPIO_ACTIVE_LOW | GPIO_PULL_UP)>  //T
      , <&gpio0 12 (GPIO_ACTIVE_LOW | GPIO_PULL_UP)> //H
      , <&gpio0 13 (GPIO_ACTIVE_LOW | GPIO_PULL_UP)> //O
      , <&gpio0 11 (GPIO_ACTIVE_LOW | GPIO_PULL_UP)> //Y
      , <&gpio0 9 (GPIO_ACTIVE_LOW | GPIO_PULL_UP)>  //SPC
      , <&gpio0 10 (GPIO_ACTIVE_LOW | GPIO_PULL_UP)> //ENT
      ;

	};

};

